## boards/shields/malgen06_keyboard2/Kconfig.defconfig
```kconfig
if SHIELD_MALGEN06_KEYBOARD2_LEFT

config ZMK_KEYBOARD_NAME
    default "mgk2"

config ZMK_SPLIT_ROLE_CENTRAL
    default y

endif # SHIELD_MALGEN06_KEYBOARD2_LEFT

if SHIELD_MALGEN06_KEYBOARD2_LEFT || SHIELD_MALGEN06_KEYBOARD2_RIGHT

config ZMK_SPLIT
    default y

endif # SHIELD_MALGEN06_KEYBOARD2_LEFT || SHIELD_MALGEN06_KEYBOARD2_RIGHT
```

## boards/shields/malgen06_keyboard2/Kconfig.shield
```kconfig
config SHIELD_MALGEN06_KEYBOARD2_LEFT
    def_bool $(shields_list_contains,malgen06_keyboard2_left)

config SHIELD_MALGEN06_KEYBOARD2_RIGHT
    def_bool $(shields_list_contains,malgen06_keyboard2_right)
```
